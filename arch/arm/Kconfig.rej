## arch/arm/Kconfig.rej
```kconfig
--- arch/arm/Kconfig
+++ arch/arm/Kconfig
@@ -1924,6 +1924,16 @@
 	  correct operation of some network protocols. With an IP-only
 	  configuration it is safe to say N, otherwise say Y.
 
+config ALLOW_CPU_ALIGNMENT
+        bool "Allow CPU-based alignment handling"
+        default y if ARCH_MSM_SCORPION || ARCH_MSM_SCORPIONMP
+        help
+          Advanced ARM processors, such as the Cortex series and ARMv7-based
+          CPUS are capable of performing unaligned accesses for many types of
+          memory accesses.  Typically, using a cpu-based alignment fixup is
+          faster than doing such a fixup in software.  For best performance
+          on advanced CPUs, say Y here.
+
 config UACCESS_WITH_MEMCPY
 	bool "Use kernel mem{cpy,set}() for {copy_to,clear}_user() (EXPERIMENTAL)"
 	depends on MMU && EXPERIMENTAL
```
